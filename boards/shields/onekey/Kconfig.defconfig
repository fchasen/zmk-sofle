## boards/shields/onekey/Kconfig.defconfig
```kconfig
# Copyright (c) 2020 The ZMK Contributors
# SPDX-License-Identifier: MIT

config ZMK_USB
	default y

if SHIELD_ONEKEY

CONFIG_BT_CTLR_TX_PWR_PLUS_8=y

config BT_CTLR
	default BT

config ZMK_KEYBOARD_NAME
    default "Sofle"

config ZMK_SPLIT_ROLE_CENTRAL
    default y

config ZMK_SPLIT
    default y

config ZMK_SPLIT_BLE_CENTRAL_PERIPHERALS
    default 2

endif
```
